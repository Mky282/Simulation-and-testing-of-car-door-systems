VERSION ""

NS_ :

BS_:

BU_: Console Engine Doors

BO_ 4 WindowState: 1 Doors
 SG_ WindowPosition : 0|4@1+ (1,0) [0|15] "" Vector__XXX

BO_ 3 WindowRq: 1 Console
 SG_ WindowRequest : 0|2@1+ (1,0) [0|2] "" Vector__XXX

BO_ 2 LockingState: 1 Doors
 SG_ LockState : 0|1@1+ (1,0) [0|1] "" Vector__XXX

BO_ 1 LockingRq: 1 Console
 SG_ LockRequest : 0|1@1+ (1,0) [0|1] "" Vector__XXX

BO_ 0 EngineStatus: 2 Engine
 SG_ Velocity : 8|8@1+ (1,0) [0|200] "" Vector__XXX
 SG_ IgnitionStatus : 0|1@1+ (1,0) [0|1] "" Vector__XXX

EV_ EnvKlemme30: 0 [0|1] "" 1 1 DUMMY_NODE_VECTOR0 Vector__XXX;

EV_ EnvKlemme15: 0 [0|1] "" 0 2 DUMMY_NODE_VECTOR0 Vector__XXX;

VAL_ 4 WindowPosition 15 "Rolled Down" 0 "Rolled Up" ;
VAL_ 3 WindowRequest 2 "Roll Window Down" 1 "Roll Window Up" 0 "Nothing" ;
VAL_ 2 LockState 1 "Unlocked" 0 "Locked" ;
VAL_ 1 LockRequest 1 "Request to Unlock" 0 "Request to Lock" ;
VAL_ 0 IgnitionStatus 1 "Engine On" 0 "Engine Off" ;
