/* !Encoding: 65001  */
includes
{
  #include "__VariablesLib.cin"
  #include "__CaplGeneratorLib.cin"
  #include "__CANoeReportFuntionsLib.cin"
}

variables
{
  // Global variables defined within this CAPL file
}

void Tthi22248_MelFunction_BinaryLink_53104f9a_861d_4579_a9ef_0d8969377478_0()
{
  TestCommandBegin(__eSet, __cSet, "", "0");
  {
  
    __ReportTableHead3Columns(__cSetCaption , __cTSym, __cTOp, __cAssigned); 
    {
      @sysvarInt::`testNS::`IgnitionStart = 1;
      __ReportTableRow(0, "System variable 'IgnitionStart'", __cAOp, 1, "Ign_ON");
    }
    __ReportTableEndTestStep("1");
  }
  TestCommandEnd();

  TestCommandBegin(__eWait, __cWait, "", "1");
  {
    __Wait("1", (500 * 1000000), 1000000, "");
  }
  TestCommandEnd();

}

void Tthi22248_MelFunction_BinaryLink_f7ec9683_19a1_45b2_94c1_666cc8b35e54_1()
{
  TestCommandBegin(__eSet, __cSet, "", "2");
  {
  
    __ReportTableHead3Columns(__cSetCaption , __cTSym, __cTOp, __cAssigned); 
    {
      @sysvarInt::`testNS::`LockRq = 1;
      __ReportTableRow(0, "System variable 'LockRq'", __cAOp, 1, "RqToUnlock");
    }
    __ReportTableEndTestStep("1");
  }
  TestCommandEnd();

}

void Tthi22248_MelFunction_Check_7289b6ed_b287_4dc3_b1c9_8ce2ebaee603_2()
{
  TestCommandBegin(__eAwaitValueMatch, __cAwaitValueMatch, "", "3");
  {
  
    dword __signalTimes[1];
    int64 __time;
    long __setFailed;
    __setFailed = 0;
    __time = 100 * 1000000;
    if (__time < 0)
    {
      testStepErrorInTestSystem(0, "1", "Unable to wait for %.3f %s. Please check input parameter.", __time / ((float)1000000), "ms");
    }
    else
    {
      __signalTimes[0] = getSignalTime(`CAN::dbNode::`Doors::`LockingState::`LockState);
      snprintf(__cArray, elCount(__cArray), "CAN signal '%s'", "LockState");
      __setFailed |= testJoinSignal(`CAN::dbNode::`Doors::`LockingState::`LockState, "__cbhi22248Callback0", __cArray, 0) < 0;
      if (__setFailed != 0)
      {
        testStepErrorInTestSystem(0, "1", "Unable to set value condition.");
      }
      else
      {
        __bVerdict = testWaitForAllJoinedEventsNS(__time) > 0;
        __ReportTableHead5Columns("Waited for occurrence of 1 value condition.", __cTSym, __cTOp, __cRefVal, __cActual, __cRes);
        __csr = CheckSignalMatch(`CAN::dbNode::`Doors::`LockingState::`LockState, 1, "==") == 1;
        __ReportTableRow(0, "CAN signal 'LockState'", "==", 1, "Unlocked");
        __ReportCell(`CAN::dbNode::`Doors::`LockingState::`LockState);
        __ReportCellResult(__csr, __ePassFail);
        __ReportTableEndVerdict("1", __bVerdict);
      }
    }
  }
  TestCommandEnd();

}

dword __cbhi22248Callback0(signal * __cbParam)
{

  __csr = CheckSignalMatch(__cbParam, 1, "==") == 1;
  return __csr;
}

void Tthi22248_MelFunction_BinaryLink_9de926a2_1677_49ae_ae30_1b2e413f6573_3()
{
  TestCommandBegin(__eSet, __cSet, "", "4");
  {
  
    __ReportTableHead3Columns(__cSetCaption , __cTSym, __cTOp, __cAssigned); 
    {
      @sysvarInt::`testNS::`LockRq = 0;
      __ReportTableRow(0, "System variable 'LockRq'", __cAOp, 0, "RqToLock");
    }
    __ReportTableEndTestStep("1");
  }
  TestCommandEnd();

}

void Tthi22248_MelFunction_Check_8e1a6003_814a_4c00_8f80_8e76e1441867_4()
{
  TestCommandBegin(__eAwaitValueMatch, __cAwaitValueMatch, "", "5");
  {
  
    dword __signalTimes[1];
    int64 __time;
    long __setFailed;
    __setFailed = 0;
    __time = 100 * 1000000;
    if (__time < 0)
    {
      testStepErrorInTestSystem(0, "1", "Unable to wait for %.3f %s. Please check input parameter.", __time / ((float)1000000), "ms");
    }
    else
    {
      __signalTimes[0] = getSignalTime(`CAN::dbNode::`Doors::`LockingState::`LockState);
      snprintf(__cArray, elCount(__cArray), "CAN signal '%s'", "LockState");
      __setFailed |= testJoinSignal(`CAN::dbNode::`Doors::`LockingState::`LockState, "__cbhi22248Callback1", __cArray, 0) < 0;
      if (__setFailed != 0)
      {
        testStepErrorInTestSystem(0, "1", "Unable to set value condition.");
      }
      else
      {
        __bVerdict = testWaitForAllJoinedEventsNS(__time) > 0;
        __ReportTableHead5Columns("Waited for occurrence of 1 value condition.", __cTSym, __cTOp, __cRefVal, __cActual, __cRes);
        __csr = CheckSignalMatch(`CAN::dbNode::`Doors::`LockingState::`LockState, 0, "==") == 1;
        __ReportTableRow(0, "CAN signal 'LockState'", "==", 0, "Locked");
        __ReportCell(`CAN::dbNode::`Doors::`LockingState::`LockState);
        __ReportCellResult(__csr, __ePassFail);
        __ReportTableEndVerdict("1", __bVerdict);
      }
    }
  }
  TestCommandEnd();

}

dword __cbhi22248Callback1(signal * __cbParam)
{

  __csr = CheckSignalMatch(__cbParam, 0, "==") == 1;
  return __csr;
}

void Tthi22248_MelFunction_BinaryLink_795f3716_fa2f_46a7_89b8_14346c9f14fa_5()
{
  TestCommandBegin(__eSet, __cSet, "", "6");
  {
  
    __ReportTableHead3Columns(__cSetCaption , __cTSym, __cTOp, __cAssigned); 
    {
      @sysvarInt::`testNS::`IgnitionStart = 0;
      __ReportTableRow(0, "System variable 'IgnitionStart'", __cAOp, 0, "Ign_OFF");
    }
    __ReportTableEndTestStep("1");
  }
  TestCommandEnd();

  TestCommandBegin(__eWait, __cWait, "", "7");
  {
    __Wait("1", (500 * 1000000), 1000000, "");
  }
  TestCommandEnd();

}

void Tthi22248_Tet_TtInit()
{

}

void Tthi22248_Tet_Tc0()
{
  CreateTTEIFFunction("Tthi22248_Tc0", __eTcDef, __eLocal);  
  CallInterfaceFunction("Test Case 1", __cEmpty , __cEmpty );
}
testcase Tthi22248_Tc0()
{	
  SetBreakOnFail(1);

  Tthi22248_MelFunction_BinaryLink_53104f9a_861d_4579_a9ef_0d8969377478_0();


  Tthi22248_MelFunction_BinaryLink_f7ec9683_19a1_45b2_94c1_666cc8b35e54_1();


  Tthi22248_MelFunction_Check_7289b6ed_b287_4dc3_b1c9_8ce2ebaee603_2();


  Tthi22248_MelFunction_BinaryLink_9de926a2_1677_49ae_ae30_1b2e413f6573_3();


  Tthi22248_MelFunction_Check_8e1a6003_814a_4c00_8f80_8e76e1441867_4();


  Tthi22248_MelFunction_BinaryLink_795f3716_fa2f_46a7_89b8_14346c9f14fa_5();


}

